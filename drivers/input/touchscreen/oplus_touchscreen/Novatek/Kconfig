## drivers/input/touchscreen/oplus_touchscreen/Novatek/Kconfig
```kconfig
config TOUCHPANEL_NT_DIGITALNOISE_TEST
#   default y
    bool "TP nova nt36672C IC add digital noise test or not for OPLUS"
    ---help---
    say Y to add digital noise test

source "drivers/input/touchscreen/oplus_touchscreen/Novatek/NT36672/Kconfig"
source "drivers/input/touchscreen/oplus_touchscreen/Novatek/NT36525/Kconfig"
source "drivers/input/touchscreen/oplus_touchscreen/Novatek/NT36672_noflash/Kconfig"
source "drivers/input/touchscreen/oplus_touchscreen/Novatek/NT36525_noflash/Kconfig"
source "drivers/input/touchscreen/oplus_touchscreen/Novatek/NT36525B_noflash/Kconfig"
source "drivers/input/touchscreen/oplus_touchscreen/Novatek/NT36672C_noflash/Kconfig"
```

## drivers/input/touchscreen/oplus_touchscreen/ilitek/Kconfig
```kconfig
source "drivers/input/touchscreen/oplus_touchscreen/ilitek/ilitek9881h/Kconfig"
source "drivers/input/touchscreen/oplus_touchscreen/ilitek/ilitek9881h_v2/Kconfig"
source "drivers/input/touchscreen/oplus_touchscreen/ilitek/ilitek9881h_v3/Kconfig"
```

## drivers/soc/Kconfig
```kconfig
menu "SOC (System On Chip) specific Drivers"

source "drivers/soc/actions/Kconfig"
source "drivers/soc/amlogic/Kconfig"
source "drivers/soc/atmel/Kconfig"
source "drivers/soc/bcm/Kconfig"
source "drivers/soc/fsl/Kconfig"
source "drivers/soc/imx/Kconfig"
source "drivers/soc/mediatek/Kconfig"
source "drivers/soc/qcom/Kconfig"
source "drivers/soc/renesas/Kconfig"
source "drivers/soc/rockchip/Kconfig"
source "drivers/soc/samsung/Kconfig"
source "drivers/soc/sunxi/Kconfig"
source "drivers/soc/tegra/Kconfig"
source "drivers/soc/ti/Kconfig"
source "drivers/soc/ux500/Kconfig"
source "drivers/soc/versatile/Kconfig"
source "drivers/soc/xilinx/Kconfig"
source "drivers/soc/zte/Kconfig"
source "drivers/soc/oplus/Kconfig"
#ifdef OPLUS_FEATURE_IOMONITOR
source "drivers/soc/oplus/iomonitor/Kconfig"
#endif /*OPLUS_FEATURE_IOMONITOR*/
#ifdef VENDOR_EDIT
#wen.luo@BSP.Kernel.Stability 2020/03/25 add for oplus kernel system
source "drivers/soc/oplus/system/Kconfig"
#endif
#ifdef OPLUS_FEATURE_HEALTHINFO
#Jiheng.Xie@BSP.Kernel.Performance 2020/06/18 add for healthinfo
source "drivers/soc/oplus/healthinfo/Kconfig"
#endif /* OPLUS_FEATURE_HEALTHINFO */

#ifdef OPLUS_FEATURE_POWERINFO_STANDBY
source "drivers/soc/oplus/owakelock/Kconfig"
#endif /* OPLUS_FEATURE_POWERINFO_STANDBY */

#ifdef OPLUS_FEATURE_HOUSTON
source "drivers/soc/oplus/houston/Kconfig"
#endif

#ifdef OPLUS_FEATURE_SENSOR_SMEM
#qiuzuolin@BSP.Sensor.Basic 2020/07/31 add for oplus sensor smem
source "drivers/soc/oplus/sensor/Kconfig"
#endif /* OPLUS_FEATURE_SENSOR_SMEM */

#Add for NandSwap
source "drivers/soc/oplus/oplus_nandswap/Kconfig"

endmenu
```

## drivers/soc/oplus/healthinfo/Kconfig
```kconfig
#ifdef OPLUS_FEATURE_HEALTHINFO
config OPLUS_HEALTHINFO
bool "config healthinfo"
help
    define this config to init  healthinfo.
#endif /* OPLUS_FEATURE_HEALTHINFO */
```
