&sdhc_1 {
//#ifdef OPLUS_FEATURE_EMMC_DRIVER
//jason.wu@BSP.Storage.UFS 2020-10-16 goku project has no emmc
        status = "disabled";
//#endif
};

&sdhc_2 {
//#ifdef OPLUS_FEATURE_EMMC_DRIVER
//jason.wu@BSP.Storage.UFS 2020-10-16 goku project has T card
        cd-gpios = <&tlmm 69 GPIO_ACTIVE_HIGH>;
        status = "ok";
//#endif
};

